## drivers/mcuio/Kconfig
```kconfig
menuconfig MCUIO
	tristate "mcuio drivers"
	select REGMAP_MCUIO
	help
	  MCUIO is a protocol and a set of drivers which let a Linux MPU
	  (MPU = MicroProcessor Unit) control an MCU's peripherals
	  (MCU = Micro Controller Unit, some kind of tiny microcontroller
	  running a tiny OS or no OS at all).

config MCUIO_LDISC_HC
	tristate "mcuio line discipline host controller"
	depends on MCUIO
	default y
	help
	  This adds a line-discipline based MCUIO host controller, which is
	  the only host controller at present. Say Y if in doubt.

config MCUIO_IRQ_CTRL
        tristate "mcuio irq controller driver"
	depends on MCUIO
	default y
	help
	  The MCUIO irq controller is needed by mcuio functions to send
	  interrupts to the MPU. If unsure say yes.
```
